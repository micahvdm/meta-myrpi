## conf/layer.conf
```bitbake
# We have a conf and classes directory, add to BBPATH
BBPATH .= ":${LAYERDIR}"

# We have recipes-* directories, add to BBFILES
BBFILES += "${LAYERDIR}/recipes-*/*/*.bb \
            ${LAYERDIR}/recipes-*/*/*/*.bbappend \
            ${LAYERDIR}/recipes-*/*/*.bbappend"

BBFILE_COLLECTIONS += "meta-myrpi"
BBFILE_PATTERN_meta-myrpi = "^${LAYERDIR}/"
# meta-raspberry-pi has priority 9 but we want that out layer to be the 
# last one to avoid being overwritten. So, we assign priority 10
# run : bitbake-layer show-layers to show the priority of all layers
# NOTE: Starting bitbake server...
# layer                 path                                      priority
# ==========================================================================
# meta                  /opt/yocto/dunfell/src/poky/meta          5
# meta-poky             /opt/yocto/dunfell/src/poky/meta-poky     5
# meta-yocto-bsp        /opt/yocto/dunfell/src/poky/meta-yocto-bsp  5
# meta-myrpi            /home/build/rpi/build/meta-myrpi       10    <======
# meta-raspberrypi      /opt/yocto/dunfell/src/meta-raspberrypi   9
# meta-oe               /opt/yocto/dunfell/src/meta-openembedded/meta-oe  6
# meta-networking       /opt/yocto/dunfell/src/meta-openembedded/meta-networking  5
# meta-python           /opt/yocto/dunfell/src/meta-openembedded/meta-python  7
BBFILE_PRIORITY_meta-myrpi = "10"

LAYERDEPENDS_meta-myrpi = "core"
LAYERSERIES_COMPAT_meta-myrpi = "dunfell"


# This sets the default machine RPi if no other machine is selected:
MACHINE ?= "raspberrypi3-64"
#Prefix to the resulting deployable tarball name
#export IMAGE_BASENAME = "Reference-Minimal-Image"
#MACHINE_NAME ?= "${MACHINE}"
#IMAGE_NAME = "${MACHINE_NAME}_${IMAGE_BASENAME}"

SSTATE_DIR = "/mnt/yocto/rpi3/shared-sstate-cache" 
DL_DIR = "/mnt/yocto/rpi3/downloads" 
TMPDIR = "/mnt/yocto/rpi3/tmp" 
  
# this is a smarter image format that can save alot of time when burning a SD card.
# use balena etcher or bmaptool for faster results
IMAGE_FSTYPES ?= "wic.bz2 wic wic.bmap"

# the recomended formats are ipk (which uses opkg) or rpm (which uses dnf)
# choose one format so that the package repository does not waste space saving package in multiple formats
PACKAGE_CLASSES = "package_ipk"

# check /opt/yocto/dunfell/src/poky/meta/recipes-kernel/linux/ for options like: "linux-yocto-rt"
#PREFERRED_PROVIDER_virtual/kernel = "linux-raspberrypi-rt"
#PREFERRED_PROVIDER_virtual/kernel = "linux-yocto"

# the next line will overwrite the default linux version defined here:
#meta-raspberrypi/conf/machine/include/rpi-default-versions.inc:PREFERRED_VERSION_linux-raspberrypi ??= "5.4.%"
#PREFERRED_VERSION_linux-libc-headers="5.15%"
#PREFERRED_VERSION_linux-raspberrypi="5.15.%"
#PREFERRED_VERSION_linux-yocto="5.15%"

# removing unsued packages
# https://stackoverflow.com/questions/28765494/yocto-minimal-image-with-package-management
# check the file for the list of features that can be excluded
# /opt/yocto/dunfell/src/poky/meta/recipes-core/packagegroups/packagegroup-base.bb:
DISTRO_FEATURES_remove = " x11 alsa touchscreen bluetooth opengl wayland apm ext2 nfs phone nfc ppp"

# enable uart serial terminal
# check https://meta-raspberrypi.readthedocs.io/en/latest/extra-build-config.html for additional parameters
ENABLE_UART = "1"

# used to check the size of the image, the dependency, size of each package, etc
# check the directory build/buildhistory/images/raspberrypi3_64/glibc/core-image-base/
INHERIT += "buildhistory"
BUILDHISTORY_COMMIT = "1"

# example of how to add something to the bootloaded 
#do_deploy_append() {
#    # Enable i2c by default
#    echo "dtparam=i2c_arm=on" >> ${DEPLOYDIR}/bcm2835-bootfiles/config.txt
#}
```
